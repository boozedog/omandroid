// SPDX-License-Identifier: MIT
/*
 * B1.3 only. Enable HSI2C15 in I2C mode at stock's 400 kHz.
 * No child is enabled. Not part of a default image.
 */
/dts-v1/;
/plugin/;

&usi15 {
	samsung,mode = <3>; /* USI_MODE_I2C */
	status = "okay";
};

&hsi2c_15 {
	clock-frequency = <400000>;
	status = "okay";
};
